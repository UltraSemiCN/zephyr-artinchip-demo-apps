## applications/dashboard_1024x600_d125_mipi/Kconfig
```kconfig
# SPDX-FileCopyrightText: Copyright (c) 2026 UltraSemi
# SPDX-License-Identifier: Apache-2.0

mainmenu "ArtInChip dashboard"

rsource "../../common/dashboard/Kconfig"
```

## applications/dashboard_720x1280_d125_mipi/Kconfig.sysbuild
```kconfig
# SPDX-FileCopyrightText: Copyright (c) 2026 UltraSemi
# SPDX-License-Identifier: Apache-2.0

source "share/sysbuild/Kconfig"

config DASHBOARD_BOOT_LOGO
	bool "Show the dashboard boot logo in MCUboot and the application"
	default y
```

## common/dashboard/Kconfig
```kconfig
# SPDX-FileCopyrightText: Copyright (c) 2026 UltraSemi
# SPDX-License-Identifier: Apache-2.0

source "Kconfig.zephyr"

config LVGL_FS_RESOURCES
	bool "LittleFS resource files on SPI NOR flash"
	help
	  Mount the data partition at /lfs and load assets from resources/.

config DASHBOARD_BOOT_LOGO
	bool "Show partner logos before dashboard creation"
	default y
	depends on DISPLAY && LVGL && LV_Z_AUTO_INIT
	depends on LV_FONT_MONTSERRAT_18
	help
	  Render the partner logos and websites after LVGL initialization,
	  before application initialization and dashboard creation. Reuse the
	  display buffers and assets, without a fixed startup delay. This does
	  not display a logo during MCUboot image loading or verification.
```

## west.yml
```yaml
# SPDX-FileCopyrightText: Copyright (c) 2026 UltraSemi
# SPDX-License-Identifier: Apache-2.0
manifest:
  version: '1.2'
  projects:
  - name: zephyr-artinchip
    url: https://github.com/UltraSemiCN/zephyr-artinchip.git
    revision: ef7fc3115be70ddf1226fc0658043b8535687b94
    path: zephyr-artinchip
    import:
      name-allowlist:
      - mcuboot
      - mbedtls
      - lvgl
      - fatfs
      - littlefs
      - zcbor
      - tf-psa-crypto
  - name: zephyr-artinchip-tools
    url: https://github.com/UltraSemiCN/zephyr-artinchip-tools.git
    revision: e5f236d66aca67263c19f27435a0bee26d5890fc
    path: zephyr-artinchip-tools
  self:
    path: zephyr-artinchip-demo-apps
```
